// Rechte Haelfte (Peripheral) - Matrix + (spaeter) TPS43-Touchpad.
// Build: shield = "jar_hillside_right"

#include "jar_hillside.dtsi"

// Rechte lokale Spalten 0..5 -> logische Spalten 6..11
&default_transform {
    col-offset = <6>;
};

/*
 * ------------------------------------------------------------------------
 * TPS43 Touchpad (Azoteq IQS5xx-Familie, I2C 7-bit-Adresse 0x74)
 * ------------------------------------------------------------------------
 * WICHTIG: ZMK v0.3 enthaelt KEINEN In-Tree-Treiber fuer dieses Touchpad.
 * Deshalb ist unten alles auskommentiert. Die Matrix funktioniert ohne das
 * Touchpad vollstaendig. Sobald ein passender ZMK-Treiber/Modul verfuegbar
 * ist (west.yml erweitern), koennen die folgenden Bloecke aktiviert werden.
 *
 * Verdrahtung laut Aufbau-Anleitung:
 *   SDA -> P1.00   SCL -> P0.24   RST -> P1.01   RDY -> P1.02
 *   3V3 -> VCC     GND -> GND     (Pull-ups 1k von SDA/SCL nach 3V3)
 *
 * &pinctrl {
 *     i2c1_default: i2c1_default {
 *         group1 {
 *             psels = <NRF_PSEL(TWIM_SDA, 1, 0)>,     // SDA P1.00
 *                 <NRF_PSEL(TWIM_SCL, 0, 24)>;        // SCL P0.24
 *         };
 *     };
 *     i2c1_sleep: i2c1_sleep {
 *         group1 {
 *             psels = <NRF_PSEL(TWIM_SDA, 1, 0)>,
 *                 <NRF_PSEL(TWIM_SCL, 0, 24)>;
 *             low-power-enable;
 *         };
 *     };
 * };
 *
 * &i2c1 {
 *     status = "okay";
 *     compatible = "nordic,nrf-twi";
 *     pinctrl-0 = <&i2c1_default>;
 *     pinctrl-1 = <&i2c1_sleep>;
 *     pinctrl-names = "default", "sleep";
 *
 *     trackpad: trackpad@74 {
 *         compatible = "azoteq,iqs5xx";   // Treiber muss vorhanden sein!
 *         reg = <0x74>;
 *         reset-gpios = <&gpio1 1 GPIO_ACTIVE_LOW>;   // RST P1.01
 *         ready-gpios = <&gpio1 2 GPIO_ACTIVE_HIGH>;  // RDY P1.02
 *     };
 * };
 */
